## sdkconfig.defaults
```kconfig
#
# Partition Table
#
CONFIG_PARTITION_TABLE_CUSTOM=y
CONFIG_PARTITION_TABLE_CUSTOM_FILENAME="partitions.csv"
CONFIG_PARTITION_TABLE_FILENAME="partitions.csv"

#
# Disable Task Watchdog Timer
#
CONFIG_ESP_TASK_WDT_EN=n

#
# ESP32-specific
#
CONFIG_ESP32_DEFAULT_CPU_FREQ_240=y
CONFIG_ESP32_DEFAULT_CPU_FREQ_MHZ=240

#
# ESP32S2-specific
#
CONFIG_ESP32S2_DEFAULT_CPU_FREQ_240=y
CONFIG_ESP32S2_DEFAULT_CPU_FREQ_MHZ=240

#
# ESP32S3-specific
#
CONFIG_ESP32S3_DEFAULT_CPU_FREQ_240=y
CONFIG_ESP32S3_DEFAULT_CPU_FREQ_MHZ=240

#
# ST7789 Configuration
#
CONFIG_GPIO_RANGE_MAX=48
CONFIG_WIDTH=240
CONFIG_HEIGHT=240
CONFIG_OFFSETX=0
CONFIG_OFFSETY=0
CONFIG_ST7789_MOSI_GPIO=13
CONFIG_ST7789_SCLK_GPIO=18
CONFIG_ST7789_CS_GPIO=12
CONFIG_ST7789_DC_GPIO=38
CONFIG_ST7789_RESET_GPIO=-1
CONFIG_BL_GPIO=45
# CONFIG_INVERSION is not set
# CONFIG_SPI2_HOST is not set
CONFIG_SPI3_HOST=y
# CONFIG_FRAME_BUFFER is not set
# end of ST7789 Configuration

#
# SX126X Configuration
#
# CONFIG_433MHZ is not set
# CONFIG_866MHZ is not set
# CONFIG_915MHZ is not set
CONFIG_OTHER=y
CONFIG_OTHER_FREQUENCY=868
# CONFIG_ADVANCED is not set
# CONFIG_USE_TCXO is not set
CONFIG_SX126X_MISO_GPIO=4
CONFIG_SX126X_SCLK_GPIO=3
CONFIG_SX126X_MOSI_GPIO=1
CONFIG_SX126X_NSS_GPIO=5
CONFIG_SX126X_RST_GPIO=8
CONFIG_SX126X_BUSY_GPIO=7
CONFIG_SX126X_TXEN_GPIO=-1
CONFIG_SX126X_RXEN_GPIO=-1
CONFIG_SPI2_HOST_SX126X=y
# CONFIG_SPI3_HOST_SX126X is not set
# end of SX126X Configuration

#
# Touch FT6X36 Configuration
#

#
# The touch chip needs an I2C port and one input GPIO
#
CONFIG_TOUCH_SDA=39
CONFIG_TOUCH_SDL=40
CONFIG_TOUCH_INT=16
CONFIG_I2C_MASTER_FREQUENCY=50000
CONFIG_L58_MULTITOUCH=0
CONFIG_FT6X36_DEBUG=1
CONFIG_FT6X36_DEBUG_EVENTS=0
# end of Touch FT6X36 Configuration



CONFIG_FREERTOS_ENABLE_BACKWARD_COMPATIBILITY=y
```
